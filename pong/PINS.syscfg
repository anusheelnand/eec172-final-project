/**
 * @cliArgs --device "CC3200" --package "Default" --part "Default"
 * @versions {"tool":"1.19.0+3426"}
 */

/**
 * These are the peripherals and settings in this configuration
 */
const iGPIO1        = scripting.addPeripheral("GPIO");
iGPIO1.$name        = "MyGPIO1";
iGPIO1.GPIO00.$used = false;
iGPIO1.GPIO01.$used = false;
iGPIO1.GPIO02.$used = false;
iGPIO1.GPIO03.io    = "output";
iGPIO1.GPIO04.$used = false;
iGPIO1.GPIO05.$used = false;
iGPIO1.GPIO06.io    = "output";
iGPIO1.GPIO07.$used = false;
iGPIO1.GPIO08.$used = false;
iGPIO1.GPIO09.$used = false;
iGPIO1.GPIO10.$used = false;
iGPIO1.GPIO11.$used = false;
iGPIO1.GPIO12.$used = false;
iGPIO1.GPIO14.$used = false;
iGPIO1.GPIO15.$used = false;
iGPIO1.GPIO16.$used = false;
iGPIO1.GPIO17.io    = "output";
iGPIO1.GPIO23.$used = false;
iGPIO1.GPIO24.$used = false;
iGPIO1.GPIO28.io    = "output";
iGPIO1.GPIO29.$used = false;
iGPIO1.GPIO25.$used = false;
iGPIO1.GPIO30.$used = false;
iGPIO1.GPIO31.$used = false;
iGPIO1.GPIO32.$used = false;
const iI2C1         = scripting.addPeripheral("I2C");
iI2C1.$name         = "MyI2C1";
const iSPI1         = scripting.addPeripheral("SPI");
iSPI1.$name         = "MySPI1";
iSPI1.CS.$used      = false;
iSPI1.MISO.$used    = false;
const iUART1        = scripting.addPeripheral("UART");
iUART1.$name        = "MyUART1";
iUART1.$assign      = "UART0";
iUART1.RTS.$used    = false;
iUART1.CTS.$used    = false;
const iUART2        = scripting.addPeripheral("UART");
iUART2.$name        = "MyUART2";
iUART2.$assign      = "UART1";
iUART2.RTS.$used    = false;
iUART2.CTS.$used    = false;
iUART2.TX.$used     = false;
iUART2.RX.$assign   = "GP31";

/**
 * Pinmux solution for unlocked pins/peripherals. This ensures that minor changes to the automatic solver in a future
 * version of the tool will not impact the pinmux you originally saw.  These lines can be completely deleted in order to
 * re-solve from scratch.
 */
iGPIO1.$suggestSolution        = "GPIO";
iGPIO1.GPIO03.$suggestSolution = "GP03";
iGPIO1.GPIO06.$suggestSolution = "GP06";
iGPIO1.GPIO13.$suggestSolution = "GP13";
iGPIO1.GPIO17.$suggestSolution = "GP17";
iGPIO1.GPIO22.$suggestSolution = "GP22";
iGPIO1.GPIO28.$suggestSolution = "GP28";
iI2C1.$suggestSolution         = "I2C0";
iI2C1.SCL.$suggestSolution     = "GP10";
iI2C1.SDA.$suggestSolution     = "GP11";
iSPI1.$suggestSolution         = "SPI0";
iSPI1.CLK.$suggestSolution     = "GP14";
iSPI1.MOSI.$suggestSolution    = "GP16";
iUART1.TX.$suggestSolution     = "GP01";
iUART1.RX.$suggestSolution     = "GP02";
